## zmk-config/config/boards/arm/corrupt/Kconfig.board
```kconfig
# SPDX-License-Identifier: MIT

config BOARD_CORRUPT
	bool "Corrupt Keyboard"
	depends on SOC_STM32F405XG
```

## zmk-config/config/boards/arm/corrupt/corrupt_defconfig
```kconfig
# SPDX-License-Identifier: MIT

CONFIG_SOC_SERIES_STM32F4X=y
CONFIG_SOC_STM32F405XG=y
# 120MHz system clock
CONFIG_SYS_CLOCK_HW_CYCLES_PER_SEC=120000000

# enable pinmux
CONFIG_PINMUX=y

# enable GPIO
CONFIG_GPIO=y

# clock configuration
CONFIG_CLOCK_CONTROL=y

# Clock configuration for Cube Clock control driver
CONFIG_CLOCK_STM32_HSE_CLOCK=25000000
CONFIG_CLOCK_STM32_SYSCLK_SRC_PLL=y
## use HSE as PLL input
CONFIG_CLOCK_STM32_PLL_SRC_HSE=y
## produce 120MHz clock at PLL output
CONFIG_CLOCK_STM32_PLL_M_DIVISOR=15
CONFIG_CLOCK_STM32_PLL_N_MULTIPLIER=144
CONFIG_CLOCK_STM32_PLL_P_DIVISOR=2
CONFIG_CLOCK_STM32_PLL_Q_DIVISOR=5
CONFIG_CLOCK_STM32_AHB_PRESCALER=1
CONFIG_CLOCK_STM32_APB1_PRESCALER=4
CONFIG_CLOCK_STM32_APB2_PRESCALER=2
```

## zmk-config/config/west.yml
```yaml
manifest:
    remotes:
        - name: atx
          url-base: https://github.com/atx
    projects:
        - name: zmk
          remote: atx
          revision: polling
          import: app/west.yml
    self:
        path: config
```
